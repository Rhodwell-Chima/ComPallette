## tools/usb_ppp_probe/main/Kconfig.projbuild
```kconfig
menu "ComPallette PPP probe"

config PROBE_DJANGO_URL
    string "Django health URL reachable from the Linux peer"
    default ""

endmenu
```

## tools/usb_ppp_probe/sdkconfig.defaults
```kconfig
CONFIG_LWIP_PPP_SUPPORT=y
CONFIG_LWIP_PPP_ENABLE_IPV6=n
CONFIG_LWIP_PPP_NOTIFY_PHASE_SUPPORT=y
CONFIG_MBEDTLS_CERTIFICATE_BUNDLE=y
CONFIG_ESP_CONSOLE_UART_DEFAULT=y
CONFIG_ESP_CONSOLE_SECONDARY_NONE=y
```
